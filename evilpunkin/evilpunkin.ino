/* Halloween pumpkin with Evil laugh.
 * Inspired by
 https://iot4kids.com/2014/10/21/easy-arduino-halloween-project-motion-sensing-pumpkin-with-an-evil-laugh/
 */

// Some Arduinos, such as the Uno R2, can't handle the full length sound.
// If you get errors uploading, try defining SMALLMEM.
#define SMALLMEM

// Use PCM audio
#include <PCM.h>

// How close, in inches, does someone need to get before we make a sound?
// The HCSR04 maxes out around 30 inches, so you need to use something
// quite a bit smaller than that.
const int CLOSE_ENOUGH = 20;

// Plug the speaker in to Gnd and pin 11: seems to be hardwired in startPlayback

// The two pins for the rangefinder:
const int triggerPin = 7;
const int    echoPin = 8;

// The LED eyes:
int  leftLED = 5;
int rightLED = 6;

// store the encoded evil laugh audio codes into an array
const unsigned char soundsample[] PROGMEM = {
#ifndef SMALLMEM
/* Comment out this large initial block to fit on an Uno R2: */
  126, 126, 127, 127, 127, 126, 127, 128, 128, 128, 128, 128,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 70,
/* Comment out everything before here to git in an Uno */
#endif /* SMALLMEM */

    119, 124, 56, 86, 118, 73, 96, 119, 83, 104, 148, 141,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 132,
};

void setup()
{
    pinMode(leftLED, OUTPUT);
    pinMode(rightLED, OUTPUT);
    pinMode(triggerPin, OUTPUT);
    pinMode(echoPin, INPUT);

    digitalWrite(triggerPin, LOW);

    Serial.begin(9600);
    Serial.println("Mwoo-ha-ha!");

    /*
    startPlayback(soundsample, sizeof(soundsample));
    delay(7000);
    stopPlayback();
    delay(2000);
    */
}

float distanceInches()
{
    // Send the trigger high for 10 microseconds or more
    digitalWrite(triggerPin, HIGH);
    delayMicroseconds(10);
    digitalWrite(triggerPin, LOW);

    int duration = pulseIn(echoPin, HIGH);
    Serial.print("Duration: ");
    Serial.print(duration);
    Serial.print(" usec");

    // About every other time, duration is negative.
    // (Or, if you read it as a long, way too high.)
    // Ignore those.
    if (duration < 0)
        return 100;

    float inches = duration/148;
    //float cm     = duration / 58;
    return inches;
}

void loop()
{
    int inches = distanceInches();
    Serial.print("     Distance: ");
    Serial.println(inches);

    // Do we see anything in front of the pumpkin?
    if (inches < CLOSE_ENOUGH)
    {
        Serial.println("Mwoo-ha-ha-ha-ha!");

        // Play the sound sample
        startPlayback(soundsample, sizeof(soundsample));

        // Fade the eyes on and off several times
        for (int i = 0; i < 3; ++i)
        {
            int val;
            for (val = 0; val < 255; ++val)
            {
                analogWrite( leftLED, val);
                analogWrite(rightLED, 255 - val);
                delay(3);
            }
            for (val = 255; val > 0; --val)
            {
                analogWrite( leftLED, val);
                analogWrite(rightLED, 255 - val);
                delay(3);
            }
        }

        // Both eyes off
        analogWrite( leftLED, 255);
        analogWrite(rightLED, 255);

        delay(2000);
        stopPlayback();

        // Both eyes off
        analogWrite( leftLED, 0);
        analogWrite(rightLED, 0);
    }

    delay(1000);
}
